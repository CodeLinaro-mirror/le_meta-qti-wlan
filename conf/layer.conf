## conf/layer.conf
```bitbake
BBFILES += "${LAYERDIR}/recipes/*/*.bb ${LAYERDIR}/recipes/*/*.bbappend ${LAYERDIR}/recipes-*/*/*.bb ${LAYERDIR}/recipes-products/images/*.bbappend"
BBPATH .= ":${LAYERDIR}"
BBFILE_COLLECTIONS += "wlan"
BBFILE_PRIORITY_wlan = "12"
BBFILE_PATTERN_wlan := "^${LAYERDIR}/"

LAYERSERIES_COMPAT_qti-wlan = "dunfell kirkstone scarthgap"
LAYERSERIES_COMPAT_wlan = "dunfell kirkstone scarthgap"
```
